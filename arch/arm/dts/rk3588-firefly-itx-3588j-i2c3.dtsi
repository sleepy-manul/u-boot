/ {
    mclkout_i2s0: mclkout-i2s0@fd58c318 {
        compatible = "rockchip,clk-out";
        reg = <0 0xfd58c318 0 0x4>;
        clocks = <&cru I2S0_8CH_MCLKOUT>;
        #clock-cells = <0>;
        clock-output-names = "i2s0_mclkout_to_io";
        rockchip,bit-shift = <0>;
        rockchip,bit-set-to-disable;
    };

/*
    es8388_sound: es8388-sound {
        status = "okay";
        compatible = "everest,es8388";
        firefly,not-use-dapm;
        hp-det-gpio = <&gpio1 RK_PC4 GPIO_ACTIVE_LOW>;
        io-channels = <&saradc 3>;
        io-channel-names = "adc-detect";
        spk-con-gpio = <&gpio3 RK_PB2 GPIO_ACTIVE_HIGH>;
        hp-con-gpio = <&gpio4 RK_PB0 GPIO_ACTIVE_HIGH>;
        linein-type = <0>;
        rockchip,format = "i2s";
        rockchip,mclk-fs = <384>;
        rockchip,cpu = <&i2s0_8ch>;
        rockchip,codec = <&es8388>;
        rockchip,audio-routing =
                "Headphone", "LOUT1",
                "Headphone", "ROUT1",
                "Speaker", "LOUT2",
                "Speaker", "ROUT2",
                "Headphone", "Headphone Power",
                "Headphone", "Headphone Power",
                "Speaker", "Speaker Power",
                "Speaker", "Speaker Power",
                "LINPUT1", "Main Mic",
                "RINPUT1", "Main Mic",
                "LINPUT2", "Headset Mic",
                "RINPUT2", "Headset Mic";
        pinctrl-names = "default";
        pinctrl-0 = <&hp_det>;
    };
*/

};

&i2c3 {
    status = "okay";
    es8388: audio-codec@11 {
        status = "okay";
        #sound-dai-cells = <0>;
        compatible = "everest,es8388";
        reg = <0x11>;
        clocks = <&mclkout_i2s0>;
        clock-names = "mclk";
        //assigned-clocks = <&mclkout_i2s0>;
        //assigned-clock-rates = <12288000>;
        pinctrl-names = "default";
        pinctrl-0 = <&i2s0_mclk>;
        AVDD-supply = <&avcc_1v8_codec_s0>;
        DVDD-supply = <&avcc_1v8_codec_s0>;
        HPVDD-supply = <&vcc_3v3_s3>;
        PVDD-supply = <&vcc_3v3_s3>;
    };

};
